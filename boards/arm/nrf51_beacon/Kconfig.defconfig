## boards/arm/nrf51_beacon/Kconfig.defconfig
```kconfig
# Kconfig - nRF51 BLENANO board configuration
#
# Copyright (c) 2016 Nordic Semiconductor ASA
#
# SPDX-License-Identifier: Apache-2.0

if BOARD_NRF51_BEACON

config BOARD
	default "nrf51_beacon"

if GPIO_NRFX

config GPIO_NRF_P0
	bool
	default y

endif # GPIO_NRFX

if UART_NRFX

config UART_0_NRF_TX_PIN
	default 9

config UART_0_NRF_RX_PIN
	default 11

endif # UART_NRFX

endif # BOARD_NRF51_BEACON
```

## boards/arm/nrf51_eysgcnzwy/Kconfig.defconfig
```kconfig
# Kconfig - nRF51 EYSGCNZWY module configuration
#
# Copyright (c) 2018 Owen Kirby <oskirby@gmail.com>
#
# SPDX-License-Identifier: Apache-2.0

if BOARD_NRF51_EYSGCNZWY

config BOARD
	default "nrf51_eysgcnzwy"

if GPIO_NRFX

config GPIO_NRF_P0
	bool
	default y

endif # GPIO_NRFX

if UART_NRFX

config UART_0_NRF_TX_PIN
	default 1

config UART_0_NRF_RX_PIN
	default 3

config UART_0_NRF_RTS_PIN
	default 0

config UART_0_NRF_CTS_PIN
	default 2

endif # UART_NRFX

endif # BOARD_NRF51_EYSGCNZWY
```
